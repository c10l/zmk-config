## boards/shields/c48/Kconfig.defconfig
```kconfig
if SHIELD_C48_LEFT
    config ZMK_KEYBOARD_NAME
        default "c48"
    config ZMK_SPLIT_BLE_ROLE_CENTRAL
        default y
endif

if SHIELD_C48_RIGHT
    config ZMK_KEYBOARD_NAME
        default "c48 Right"
endif

config ZMK_SPLIT
    default y

if ZMK_BACKLIGHT

config PWM
    default y

config LED_PWM
    default y

endif # ZMK_BACKLIGHT
```

## boards/shields/c48/Kconfig.shield
```kconfig
config SHIELD_C48_LEFT
    def_bool $(shields_list_contains,c48_left)

config SHIELD_C48_RIGHT
    def_bool $(shields_list_contains,c48_right)
```
