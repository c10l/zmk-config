// c48_left.overlay

#include "c48.dtsi" // Notice that the main dtsi files are included in the overlay.

&kscan0 {
    col-gpios =
        <&gpio0 2  GPIO_ACTIVE_HIGH>, // col4 in the schematic
        <&gpio0 29 GPIO_ACTIVE_HIGH>, // col3 in the schematic
        <&gpio0 31 GPIO_ACTIVE_HIGH>, // col2 in the schematic
        <&gpio1 6  GPIO_ACTIVE_HIGH>, // col1 in the schematic
        <&gpio1 4  GPIO_ACTIVE_HIGH>  // col0 in the schematic
        ;
};
